/* Copyright (c) 2013, The Linux Foundation. All rights reserved.
 *
 * This program is free software; you can redistribute it and/or modify
 * it under the terms of the GNU General Public License version 2 and
 * only version 2 as published by the Free Software Foundation.
 *
 * This program is distributed in the hope that it will be useful,
 * but WITHOUT ANY WARRANTY; without even the implied warranty of
 * MERCHANTABILITY or FITNESS FOR A PARTICULAR PURPOSE.  See the
 * GNU General Public License for more details.
 */

/*---------------------------------------------------------------------------
 * This file is autogenerated file using gcdb parser. Please do not edit it.
 * Update input XML file to add a new entry or update variable in this file
 * VERSION = "1.0"
 *---------------------------------------------------------------------------*/
&mdss_mdp {
	dsi_boyiotm1284a_720p_vid: qcom,mdss_dsi_boyiotm1284a_720p_video {
		qcom,mdss-dsi-panel-name = "BOYI OTM284A video mode dsi panel";
		qcom,mdss-dsi-panel-controller = <&mdss_dsi0>;
		qcom,mdss-dsi-panel-type = "dsi_video_mode";
		qcom,mdss-dsi-panel-destination = "display_1";
		qcom,cont-splash-enabled;
		qcom,mdss-dsi-panel-framerate = <60>;
		qcom,mdss-dsi-virtual-channel-id = <0>;
		qcom,mdss-dsi-stream = <0>;
		qcom,mdss-dsi-panel-width = <720>;
		qcom,mdss-dsi-panel-height = <1280>;
		qcom,mdss-dsi-h-front-porch = <40>;
		qcom,mdss-dsi-h-back-porch = <30>;
		qcom,mdss-dsi-h-pulse-width = <12>;
		qcom,mdss-dsi-h-sync-skew = <0>;
		qcom,mdss-dsi-v-front-porch = <40>;
		qcom,mdss-dsi-v-back-porch = <11>;
		qcom,mdss-dsi-v-pulse-width = <2>;
		qcom,mdss-dsi-h-left-border = <0>;
		qcom,mdss-dsi-h-right-border = <0>;
		qcom,mdss-dsi-v-top-border = <0>;
		qcom,mdss-dsi-v-bottom-border = <0>;
		qcom,mdss-dsi-bpp = <24>;
		qcom,mdss-dsi-color-order = "rgb_swap_rgb";
		qcom,mdss-dsi-underflow-color = <0xff>;
		qcom,mdss-dsi-border-color = <0>;
		qcom,mdss-dsi-on-command = [
					23 01 00 00 00 00 02
						00 00
					29 01 00 00 00 00 04
						FF 12 84 01
					23 01 00 00 00 00 02
						00 80
					29 01 00 00 00 00 03
						FF 12 84
					23 01 00 00 00 00 02
						00 80
					29 01 00 00 00 00 0A
						C0 00 64 00
						10 10 00 64
						10 10
					23 01 00 00 00 00 02
						00 90
					29 01 00 00 00 00 07
						C0 00 5B 00
						01 00 04
					23 01 00 00 00 00 02
						00 A2
					23 01 00 00 00 00 02
						C0 00
					23 01 00 00 00 00 02
						00 A3
					23 01 00 00 00 00 02
						C0 02
					23 01 00 00 00 00 02
						00 A4
					23 01 00 00 00 00 02
						C0 02
					23 01 00 00 00 00 02
						00 B3
					29 01 00 00 00 00 03
						C0 00 55
					23 01 00 00 00 00 02
						00 81
					23 01 00 00 00 00 02
						C1 55
					23 01 00 00 00 00 02
						36 00
					23 01 00 00 00 00 02
						00 A0
					29 01 00 00 00 00 0F
						C4 05 10 06
						02 05 15 10
						05 10 07 02
						05 15 10
					23 01 00 00 00 00 02
						00 B0
					29 01 00 00 00 00 03
						C4 00 00
					23 01 00 00 00 00 02
						00 91
					29 01 00 00 00 00 03
						C5 46 42
					23 01 00 00 00 00 02
						00 00
					29 01 00 00 00 00 03
						D8 CF CF
					23 01 00 00 00 00 02
						00 00
					23 01 00 00 00 00 02
						D9 7C
					23 01 00 00 00 00 02
						00 B3
					23 01 00 00 00 00 02
						C5 84
					23 01 00 00 00 00 02
						00 BB
					23 01 00 00 00 00 02
						C5 8A
					23 01 00 00 00 00 02
						00 80
					29 01 00 00 00 00 03
						C4 00 80
					23 01 00 00 00 00 02
						00 82
					23 01 00 00 00 00 02
						C4 0A
					23 01 00 00 00 00 02
						00 C6
					23 01 00 00 00 00 02
						B0 03
					23 01 00 00 00 00 02
						00 C2
					23 01 00 00 00 00 02
						F5 40
					23 01 00 00 00 00 02
						00 C3
					23 01 00 00 00 00 02
						F5 85
					23 01 00 00 00 00 02
						00 00
					23 01 00 00 00 00 02
						D0 40
					23 01 00 00 00 00 02
						00 00
					29 01 00 00 00 00 03
						D1 00 00
					23 01 00 00 00 00 02
						00 80
					29 01 00 00 00 00 0C
						CB 00 00 00
						00 00 00 00
						00 00 00 00
					23 01 00 00 00 00 02
						00 90
					29 01 00 00 00 00 10
						CB 00 00 00
						00 00 00 00
						00 00 00 00
						00 00 00 00
					23 01 00 00 00 00 02
						00 A0
					29 01 00 00 00 00 10
						CB 00 00 00
						00 00 00 00
						00 00 00 00
						00 00 00 00
					23 01 00 00 00 00 02
						00 B0
					29 01 00 00 00 00 10
						CB 00 00 00
						00 00 00 00
						00 00 00 00
						00 00 00 00
					23 01 00 00 00 00 02
						00 C0
					29 01 00 00 00 00 10
						CB 05 05 05
						05 05 05 05
						05 05 00 00
						00 00 00 00
					23 01 00 00 00 00 02
						00 D0
					29 01 00 00 00 00 10
						CB 05 00 00
						00 00 00 00
						05 05 05 05
						05 05 05 05
					23 01 00 00 00 00 02
						00 E0
					29 01 00 00 00 00 0F
						CB 05 00 00
						00 00 00 00
						05 00 00 00
						00 00 00
					23 01 00 00 00 00 02
						00 F0
					29 01 00 00 00 00 0C
						CB FF FF FF
						FF FF FF FF
						FF FF FF FF
					23 01 00 00 00 00 02
						00 80
					29 01 00 00 00 00 10
						CC 2E 2D 29
						2A 0A 0C 0E
						10 02 00 00
						00 00 00 00
					23 01 00 00 00 00 02
						00 90
					29 01 00 00 00 00 10
						CC 04 00 00
						00 00 00 00
						2E 2D 29 2A
						09 0B 0D 0F
					23 01 00 00 00 00 02
						00 A0						
					29 01 00 00 00 00 0F
						CC 01 00 00
						00 00 00 00
						03 00 00 00
						00 00 00			
					23 01 00 00 00 00 02
						00 B0		
					29 01 00 00 00 00 10
						CC 2D 2E 29
						2A 0F 0D 0B
						09 03 00 00
						00 00 00 00
					23 01 00 00 00 00 02
						00 C0
					29 01 00 00 00 00 10
						CC 01 00 00
						00 00 00 00
						2D 2E 29 2A
						10 0E 0C 0A			
					23 01 00 00 00 00 02
						00 D0
					29 01 00 00 00 00 0F
						CC 04 00 00
						00 00 00 00
						02 00 00 00
						00 00 00
					23 01 00 00 00 00 02
						00 B5
					29 01 00 00 00 00 07
						C5 0F 81 FF
						0F 81 FF
					23 01 00 00 00 00 02
						00 80
					29 01 00 00 00 00 0D
						CE 8B 03 18
						8A 03 18 89
						03 18 88 03
						18
					23 01 00 00 00 00 02
						00 90
					29 01 00 00 00 00 0F
						CE 34 FD 18
						34 FF 18 00
						00 00 00 00
						00 00 00
					23 01 00 00 00 00 02
						00 A0
					29 01 00 00 00 00 0F
						CE 38 03 05
						01 00 18 00
						38 02 05 02
						00 18 00
					23 01 00 00 00 00 02
						00 B0
					29 01 00 00 00 00 0F
						CE 38 01 05
						03 00 18 00
						38 00 05 04
						00 18 00
					23 01 00 00 00 00 02
						00 C0
					29 01 00 00 00 00 0F
						CE 38 07 04
						FD 00 18 00
						38 06 04 FE
						00 18 00
					23 01 00 00 00 00 02
						00 D0
					29 01 00 00 00 00 0F
						CE 38 05 04
						FF 00 18 00
						38 04 05 00
						00 18 00
					23 01 00 00 00 00 02
						00 80
					29 01 00 00 00 00 0F
						CF 00 00 00
						00 00 00 00
						00 00 00 00
						00 00 00
					23 01 00 00 00 00 02
						00 90
					29 01 00 00 00 00 0F
						CF 00 00 00
						00 00 00 00
						00 00 00 00
						00 00 00
					23 01 00 00 00 00 02
						00 A0
					29 01 00 00 00 00 0F
						CF 00 00 00
						00 00 00 00
						00 00 00 00
						00 00 00
					23 01 00 00 00 00 02
						00 B0
					29 01 00 00 00 00 0F
						CF 00 00 00
						00 00 00 00
						00 00 00 00
						00 00 00
					23 01 00 00 00 00 02
						00 C0
					29 01 00 00 00 00 0C
						CF 3D 02 15
						20 00 00 01
						80 00 03 35
					23 01 00 00 00 00 02
						00 90
					29 01 00 00 00 00 05
						F5 02 11 02
						15
					23 01 00 00 00 00 02
						00 90
					23 01 00 00 00 00 02
						C5 50
					23 01 00 00 00 00 02
						00 94
					29 01 00 00 00 00 04
						C5 77 33 30
					23 01 00 00 00 00 02
						00 97
					23 01 00 00 00 00 02
						C5 30
					23 01 00 00 00 00 02
						00 B2
					29 01 00 00 00 00 03
						F5 00 00
					23 01 00 00 00 00 02
						00 B4
					29 01 00 00 00 00 03
						F5 00 00
					23 01 00 00 00 00 02
						00 B6
					29 01 00 00 00 00 03
						F5 00 00
					23 01 00 00 00 00 02
						00 B8
					29 01 00 00 00 00 03
						F5 00 00
					23 01 00 00 00 00 02
						00 94
					29 01 00 00 00 00 03
						F5 00 00
					23 01 00 00 00 00 02
						00 D2
					29 01 00 00 00 00 03
						F5 06 15
					23 01 00 00 00 00 02
						00 B4
					23 01 00 00 00 00 02
						C5 CC	
					23 01 00 00 00 00 02
						00 00
					29 01 00 00 00 00 15
						E1 00 18 28
						37 46 49 56
						7F 6E 86 7D
						68 78 53 50
						42 34 26 1F
						00
					23 01 00 00 00 00 02
						00 00	
					29 01 00 00 00 00 15
						E2 00 18 28
						37 46 49 56
						7F 6E 86 7D
						68 78 53 50
						42 34 26 1F
						00
					23 01 00 00 00 00 02
						00 00	
					29 01 00 00 00 00 04
						FF FF FF FF
					05 01 00 00 7F 00 02
						11 00
					05 01 00 00 14 00 02
						29 00
					];
		qcom,mdss-dsi-off-command = [05 01 00 00 32 00 02 28 00
					05 01 00 00 78 00 02 10 00
					];
		qcom,mdss-dsi-on-command-state = "dsi_lp_mode";
		qcom,mdss-dsi-off-command-state = "dsi_lp_mode";
                qcom,mdss-dsi-panel-status-command = [06 01 00 01 05 00 02 0A 08];
                qcom,mdss-dsi-panel-status-command-state = "dsi_lp_mode";
                qcom,mdss-dsi-panel-status-check-mode = "reg_read";
                qcom,mdss-dsi-panel-status-value = <0x9c>;
                qcom,esd-check-enabled;
		qcom,mdss-dsi-h-sync-pulse = <0>;
		qcom,mdss-dsi-traffic-mode = "non_burst_sync_pulse";
		qcom,mdss-dsi-lane-map = "lane_map_0123";
		qcom,mdss-dsi-bllp-eof-power-mode;
		qcom,mdss-dsi-bllp-power-mode;
		qcom,mdss-dsi-lane-0-state;
		qcom,mdss-dsi-lane-1-state;
		qcom,mdss-dsi-lane-2-state;
		qcom,mdss-dsi-lane-3-state;
		qcom,mdss-dsi-panel-timings = [b0 23 1b 00 94 93 1e 25  15 03 04 00];
		qcom,mdss-dsi-t-clk-post = <0x04>;
		qcom,mdss-dsi-t-clk-pre = <0x1b>;
		qcom,mdss-dsi-bl-min-level = <1>;
		qcom,mdss-dsi-bl-max-level = <4095>;
		qcom,mdss-dsi-dma-trigger = "trigger_sw";
		qcom,mdss-dsi-mdp-trigger = "none";
		qcom,mdss-dsi-bl-pmic-control-type = "bl_ctrl_pwm";
		qcom,mdss-dsi-bl-pmic-pwm-frequency = <100>;
		qcom,mdss-dsi-bl-pmic-bank-select = <0>;
		qcom,mdss-dsi-pwm-gpio = <&pm8916_mpps 4 0>;
		qcom,mdss-dsi-reset-sequence = <1 20>, <0 10>, <1 20>;

	};
};
