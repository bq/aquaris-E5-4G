/* Copyright (c) 2013, The Linux Foundation. All rights reserved.
 *
 * This program is free software; you can redistribute it and/or modify
 * it under the terms of the GNU General Public License version 2 and
 * only version 2 as published by the Free Software Foundation.
 *
 * This program is distributed in the hope that it will be useful,
 * but WITHOUT ANY WARRANTY; without even the implied warranty of
 * MERCHANTABILITY or FITNESS FOR A PARTICULAR PURPOSE.  See the
 * GNU General Public License for more details.
 */

/*---------------------------------------------------------------------------
 * This file is autogenerated file using gcdb parser. Please do not edit it.
 * Update input XML file to add a new entry or update variable in this file
 * VERSION = "1.0"
 *---------------------------------------------------------------------------*/
&mdss_mdp {
	dsi_boeotm8018b_fwvga_vid: qcom,mdss_dsi_boeotm8018b_fwvga_video {
		qcom,mdss-dsi-panel-name = "BOE OTM8018B video mode dsi panel";
		qcom,mdss-dsi-panel-controller = <&mdss_dsi0>;
		qcom,mdss-dsi-panel-type = "dsi_video_mode";
		qcom,mdss-dsi-panel-destination = "display_1";
		qcom,cont-splash-enabled;
		qcom,mdss-dsi-panel-framerate = <60>;
		qcom,mdss-dsi-virtual-channel-id = <0>;
		qcom,mdss-dsi-stream = <0>;
		qcom,mdss-dsi-panel-width = <480>;
		qcom,mdss-dsi-panel-height = <854>;
		qcom,mdss-dsi-h-front-porch = <80>;
		qcom,mdss-dsi-h-back-porch = <80>;
		qcom,mdss-dsi-h-pulse-width = <10>;
		qcom,mdss-dsi-h-sync-skew = <0>;
		qcom,mdss-dsi-v-back-porch = <50>;
		qcom,mdss-dsi-v-front-porch = <10>;
		qcom,mdss-dsi-v-pulse-width = <10>;
		qcom,mdss-dsi-h-left-border = <0>;
		qcom,mdss-dsi-h-right-border = <0>;
		qcom,mdss-dsi-v-top-border = <0>;
		qcom,mdss-dsi-v-bottom-border = <20>;
		qcom,mdss-dsi-bpp = <24>;
		qcom,mdss-dsi-color-order = "rgb_swap_rgb";
		qcom,mdss-dsi-underflow-color = <0xff>;
		qcom,mdss-dsi-border-color = <0>;
		qcom,mdss-dsi-on-command = [
					23 01 00 00 00 00 02
						00 00
					29 01 00 00 00 00 04
						FF 80 09 01
					23 01 00 00 00 00 02
						00 80
					29 01 00 00 00 00 03
						FF 80 09
					23 01 00 00 00 00 02
						00 03
					23 01 00 00 00 00 02
						FF 01
					23 01 00 00 00 00 02
						00 90
					23 01 00 00 00 00 02
						B3 02
					23 01 00 00 00 00 02
						00 92
					23 01 00 00 00 00 02
						B3 45	
					23 01 00 00 00 00 02
						00 A3
					23 01 00 00 00 00 02
						C0 1B
					23 01 00 00 00 00 02
						00 80
					29 01 00 00 00 00 0A
						C0 00 58 00
						14 16 00 58
						14 16  																				
					23 01 00 00 00 00 02
						00 B4
					23 01 00 00 00 00 02
						C0 50
					23 01 00 00 00 00 02
						00 B5	
					23 01 00 00 00 00 02
						C0 48
					23 01 00 00 00 00 02
						00 80
					23 01 00 00 00 00 02
						C4 30
					23 01 00 00 00 00 02
						00 81	
					23 01 00 00 00 00 02
						C4 04
					23 01 00 00 00 00 02
						00 80
					23 01 00 00 00 00 02
						C5 03
					23 01 00 00 00 00 02
						00 90
					29 01 00 00 00 00 07
						C0 00 59 00
						00 00 03				
					23 01 00 00 00 00 02
						00 A6
					29 01 00 00 00 00 04
						C1 01 00 00
					23 01 00 00 00 00 02
						00 A0
					23 01 00 00 00 00 02
						C1 EA
					23 01 00 00 00 00 02
						00 C6
					23 01 00 00 00 00 02
						B0 03
					23 01 00 00 00 00 02
						00 8B
					23 01 00 00 00 00 02
						B0 40
					23 01 00 00 00 00 02
						00 82
					23 01 00 00 00 00 02
						C5 03
					23 01 00 00 00 00 02
						00 90
					29 01 00 00 00 00 06
						C5 96 79 00
						7b 44		
					23 01 00 00 00 00 02
						00 00
					29 01 00 00 00 00 03
						D8 5F 5F	
					23 01 00 00 00 00 02
						00 81
					23 01 00 00 00 00 02
						C1 77 
					23 01 00 00 00 00 02
						00 A1
					23 01 00 00 00 00 02
						C1 08
					23 01 00 00 00 00 02
						00 B1 
					23 01 00 00 00 00 02
						C5 29
					23 01 00 00 00 00 02
						00 80
					29 01 00 00 00 00 0D
						CE 86 01 00
						85 01 00 00
						00 00 00 00
						00
					23 01 00 00 00 00 02
						00 A0
					29 01 00 00 00 00 0F
						CE 18 05 83
						5A 86 04 00
						18 04 83 5B
						86 04 00
					23 01 00 00 00 00 02
						00 B0
					29 01 00 00 00 00 0F
						CE 18 03 83
						5C 86 04 00
						18 02 83 5D
						86 04 00
					23 01 00 00 00 00 02
						00 C0
					29 01 00 00 00 00 0B
						CF 01 01 20
						20 00 00 01
						01 00 00	
					23 01 00 00 00 00 02
						00 D0
					23 01 00 00 00 00 02
						CF 00
					23 01 00 00 00 00 02
						00 80
					29 01 00 00 00 00 0B
						CB 00 00 00
						00 00 00 00
						00 00 00
					23 01 00 00 00 00 02
						00 90
					29 01 00 00 00 00 10
						CB 00 00 00
						00 00 00 00
						00 00 00 00
						00 00 00 00
					23 01 00 00 00 00 02
						00 A0
					29 01 00 00 00 00 10
						CB 00 00 00
						00 00 00 00
						00 00 00 00
						00 00 00 00
					23 01 00 00 00 00 02
						00 B0
					29 01 00 00 00 00 0B
						CB 00 00 00
						00 00 00 00
						00 00 00
					23 01 00 00 00 00 02
						00 C0
					29 01 00 00 00 00 10
						CB 00 04 04
						04 04 04 00
						00 00 00 00
						00 00 00 00
					23 01 00 00 00 00 02
						00 D0
					29 01 00 00 00 00 10
						CB 00 00 00
						00 00 00 04
						04 04 04 04
						00 00 00 00
					23 01 00 00 00 00 02
						00 E0
					29 01 00 00 00 00 0B
						CB 00 00 00
						00 00 00 00
						00 00 00
					23 01 00 00 00 00 02
						00 F0
					29 01 00 00 00 00 0B
						CB FF FF FF
						FF FF FF FF
						FF FF FF
					23 01 00 00 00 00 02
						00 80
					29 01 00 00 00 00 0B
						CC 00 26 09
						0B 01 25 00
						00 00 00
					23 01 00 00 00 00 02
						00 90
					29 01 00 00 00 00 10
						CC 00 00 00
						00 00 00 00
						00 00 00 00
						26 0A 0C 02
					23 01 00 00 00 00 02
						00 A0						
					29 01 00 00 00 00 10
						CC 25 00 00
						00 00 00 00
						00 00 00 00
						00 00 00 00			
					23 01 00 00 00 00 02
						00 B0		
					29 01 00 00 00 00 0B
						CC 00 25 0A
						0C 02 26 00
						00 00 00
					23 01 00 00 00 00 02
						00 C0
					29 01 00 00 00 00 10
						CC 00 00 00
						00 00 00 00
						00 00 00 00
						25 09 0B 01			
					23 01 00 00 00 00 02
						00 D0
					29 01 00 00 00 00 10
						CC 26 00 00
						00 00 00 00
						00 00 00 00
						00 00 00 00	
					23 01 00 00 00 00 02
						00 00
					23 01 00 00 00 00 02
						36 00
					23 01 00 00 00 00 02
						00 88
					23 01 00 00 00 00 02
						C4 80
					23 01 00 00 00 00 02
						00 87
					23 01 00 00 00 00 02
						C4 08
					23 01 00 00 00 00 02
						00 89
					23 01 00 00 00 00 02
						C4 08
					//23 01 00 00 00 00 02
					//	21 00
					23 01 00 00 00 00 02
						00 B2
					29 01 00 00 00 00 05
						F5 15 00 15
						00 		
					23 01 00 00 00 00 02
						00 00
					29 01 00 00 00 00 11
						E1 00 08 12
						12 0B 1D 0C
						0B 02 07 03
						06 0F 20 1D
						00		 											
					23 01 00 00 00 00 02
						00 00	
					29 01 00 00 00 00 11
						E2 00 07 12
						12 0B 1E 0D
						0C 03 07 03
						06 0F 21 1D
						00
					23 01 00 00 00 00 02
						D0 41
					29 01 00 00 00 00 03
						D1 42 43
					23 01 00 00 00 00 02
						00 00
					29 01 00 00 00 00 04
						FF FF FF FF
					05 01 00 00 C8 00 02
						11 00
					05 01 00 00 32 00 02
						29 00
							
						
																																																																		
					];
		qcom,mdss-dsi-off-command = [05 01 00 00 32 00 02 28 00
					05 01 00 00 78 00 02 10 00];
		qcom,mdss-dsi-on-command-state = "dsi_lp_mode";
		qcom,mdss-dsi-off-command-state = "dsi_lp_mode";
		qcom,mdss-dsi-h-sync-pulse = <1>;
		qcom,mdss-dsi-traffic-mode = "non_burst_sync_pulse";
		qcom,mdss-dsi-lane-map = "lane_map_3012";
		qcom,mdss-dsi-bllp-eof-power-mode;
		qcom,mdss-dsi-bllp-power-mode;
		qcom,mdss-dsi-lane-0-state;
		qcom,mdss-dsi-lane-1-state;
		qcom,mdss-dsi-panel-timings = [7A 1A 12  00 40 42
						 16 1E 14  03 04 00];
		qcom,mdss-dsi-t-clk-post = <0x04>;
		qcom,mdss-dsi-t-clk-pre = <0x1b>;
		qcom,mdss-dsi-bl-min-level = <1>;
		qcom,mdss-dsi-bl-max-level = <4095>;
		qcom,mdss-dsi-dma-trigger = "trigger_sw";
		qcom,mdss-dsi-mdp-trigger = "none";
		qcom,mdss-dsi-bl-pmic-control-type = "bl_ctrl_pwm";
		qcom,mdss-dsi-bl-pmic-pwm-frequency = <100>;
		qcom,mdss-dsi-bl-pmic-bank-select = <0>;
		qcom,mdss-dsi-pwm-gpio = <&pm8916_mpps 4 0>;
		qcom,mdss-dsi-reset-sequence = <1 20>, <0 10>, <1 20>;

	};
};
