/* Copyright (c) 2013, The Linux Foundation. All rights reserved.
 *
 * This program is free software; you can redistribute it and/or modify
 * it under the terms of the GNU General Public License version 2 and
 * only version 2 as published by the Free Software Foundation.
 *
 * This program is distributed in the hope that it will be useful,
 * but WITHOUT ANY WARRANTY; without even the implied warranty of
 * MERCHANTABILITY or FITNESS FOR A PARTICULAR PURPOSE.  See the
 * GNU General Public License for more details.
 */

/*---------------------------------------------------------------------------
 * This file is autogenerated file using gcdb parser. Please do not edit it.
 * Update input XML file to add a new entry or update variable in this file
 * VERSION = "1.0"
 *---------------------------------------------------------------------------*/
&mdss_mdp {
	dsi_yassyili9806e_fwvga_vid: qcom,mdss_dsi_yassyili9806e_fwvga_video {
		qcom,mdss-dsi-panel-name = "YASSY ILI9806E video mode dsi panel";
		qcom,mdss-dsi-panel-controller = <&mdss_dsi0>;
		qcom,mdss-dsi-panel-type = "dsi_video_mode";
		qcom,mdss-dsi-panel-destination = "display_1";
		qcom,cont-splash-enabled;
		qcom,mdss-dsi-panel-framerate = <60>;
		qcom,mdss-dsi-virtual-channel-id = <0>;
		qcom,mdss-dsi-stream = <0>;
		qcom,mdss-dsi-panel-width = <480>;
		qcom,mdss-dsi-panel-height = <854>;
		qcom,mdss-dsi-h-front-porch = <80>;
		qcom,mdss-dsi-h-back-porch = <80>;
		qcom,mdss-dsi-h-pulse-width = <10>;
		qcom,mdss-dsi-h-sync-skew = <0>;
		qcom,mdss-dsi-v-back-porch = <15>;
		qcom,mdss-dsi-v-front-porch = <16>;
		qcom,mdss-dsi-v-pulse-width = <6>;
		qcom,mdss-dsi-h-left-border = <0>;
		qcom,mdss-dsi-h-right-border = <0>;
		qcom,mdss-dsi-v-top-border = <0>;
		qcom,mdss-dsi-v-bottom-border = <0>;
		qcom,mdss-dsi-bpp = <24>;
		qcom,mdss-dsi-color-order = "rgb_swap_rgb";
		qcom,mdss-dsi-underflow-color = <0xff>;
		qcom,mdss-dsi-border-color = <0>;
		qcom,mdss-dsi-on-command = [
					29 01 00 00 00 00 06
						FF FF 98 06
						04 01
					23 01 00 00 00 00 02
						08 10	
					23 01 00 00 00 00 02
						21 01
					23 01 00 00 00 00 02
						30 01
					23 01 00 00 00 00 02
						31 00			
					23 01 00 00 00 00 02
						60 07
					23 01 00 00 00 00 02
						61 03
					23 01 00 00 00 00 02
						62 06
					23 01 00 00 00 00 02
						63 07
					23 01 00 00 00 00 02
						40 10
					23 01 00 00 00 00 02
						41 33
					23 01 00 00 00 00 02
						42 03
					23 01 00 00 00 00 02
						43 09
					23 01 00 00 00 00 02
						44 0C
					23 01 00 00 00 00 02
						50 88
					23 01 00 00 00 00 02
						51 88
					23 01 00 00 00 00 02
						52 00
					23 01 00 00 00 00 02
						53 24
					23 01 00 00 00 00 02
						57 50	
					23 01 00 00 00 00 02
						A0 00
					23 01 00 00 00 00 02
						A1 09
					23 01 00 00 00 00 02
						A2 14
					23 01 00 00 00 00 02
						A3 13
					23 01 00 00 00 00 02
						A4 0D
					23 01 00 00 00 00 02
						A5 18
					23 01 00 00 00 00 02
						A6 0A
					23 01 00 00 00 00 02
						A7 08
					23 01 00 00 00 00 02
						A8 07
					23 01 00 00 00 00 02
						A9 0D
					23 01 00 00 00 00 02
						AA 09
					23 01 00 00 00 00 02
						AB 07
					23 01 00 00 00 00 02
						AC 0B
					23 01 00 00 00 00 02
						AD 2A
					23 01 00 00 00 00 02
						AE 26
					23 01 00 00 00 00 02
						AF 00
					23 01 00 00 00 00 02
						C0 00
					23 01 00 00 00 00 02
						C1 08
					23 01 00 00 00 00 02
						C2 13
					23 01 00 00 00 00 02
						C3 15
					23 01 00 00 00 00 02
						C4 0C
					23 01 00 00 00 00 02
						C5 1D
					23 01 00 00 00 00 02
						C6 0B
					23 01 00 00 00 00 02
						C7 09
					23 01 00 00 00 00 02
						C8 00
					23 01 00 00 00 00 02
						C9 04
					23 01 00 00 00 00 02
						CA 01
					23 01 00 00 00 00 02
						CB 02
					23 01 00 00 00 00 02
						CC 0A	
					23 01 00 00 00 00 02
						CD 2B
					23 01 00 00 00 00 02
						CE 27
					23 01 00 00 00 00 02
						CF 00
					29 01 00 00 00 00 06
						FF FF 98 06
						04 07
					23 01 00 00 00 00 02
						17 22
					23 01 00 00 00 00 02
						02 77
					23 01 00 00 00 00 02
						E1 79																																																																														
					29 01 00 00 00 00 06
						FF FF 98 06
						04 06
					23 01 00 00 00 00 02
						00 21
					23 01 00 00 00 00 02
						01 06
					23 01 00 00 00 00 02
						02 00
					23 01 00 00 00 00 02
						03 00
					23 01 00 00 00 00 02
						04 16
					23 01 00 00 00 00 02
						05 16
					23 01 00 00 00 00 02
						06 80
					23 01 00 00 00 00 02
						07 02
					23 01 00 00 00 00 02
						08 07
					23 01 00 00 00 00 02
						09 00
					23 01 00 00 00 00 02
						0A 00
					23 01 00 00 00 00 02
						0B 00
					23 01 00 00 00 00 02
						0C 16
					23 01 00 00 00 00 02
						0D 16
					23 01 00 00 00 00 02
						0E 00
					23 01 00 00 00 00 02
						0F 00
					23 01 00 00 00 00 02
						10 77
					23 01 00 00 00 00 02
						11 F0
					23 01 00 00 00 00 02
						12 00
					23 01 00 00 00 00 02
						13 00
					23 01 00 00 00 00 02
						14 00
					23 01 00 00 00 00 02
						15 C0
					23 01 00 00 00 00 02
						16 08
					23 01 00 00 00 00 02
						17 00
					23 01 00 00 00 00 02
						18 00
					23 01 00 00 00 00 02
						19 00
					23 01 00 00 00 00 02
						1A 00
					23 01 00 00 00 00 02
						1B 00
					23 01 00 00 00 00 02
						1C 00
					23 01 00 00 00 00 02
						1D 00
					23 01 00 00 00 00 02
						20 01
					23 01 00 00 00 00 02
						21 23
					23 01 00 00 00 00 02
						22 45
					23 01 00 00 00 00 02
						23 67
					23 01 00 00 00 00 02
						24 01
					23 01 00 00 00 00 02
						25 23
					23 01 00 00 00 00 02
						26 45
					23 01 00 00 00 00 02
						27 67
					23 01 00 00 00 00 02
						30 11
					23 01 00 00 00 00 02
						31 22
					23 01 00 00 00 00 02
						32 11
					23 01 00 00 00 00 02
						33 00
					23 01 00 00 00 00 02
						34 66
					23 01 00 00 00 00 02
						35 88
					23 01 00 00 00 00 02
						36 22
					23 01 00 00 00 00 02
						37 22
					23 01 00 00 00 00 02
						38 AA
					23 01 00 00 00 00 02
						39 CC
					23 01 00 00 00 00 02
						3A BB
					23 01 00 00 00 00 02
						3B DD
					23 01 00 00 00 00 02
						3C 22
					23 01 00 00 00 00 02
						3D 22
					23 01 00 00 00 00 02
						3E 22
					23 01 00 00 00 00 02
						3F 22
					23 01 00 00 00 00 02
						40 22
					23 01 00 00 00 00 02
						52 10
					23 01 00 00 00 00 02
						53 10		
					29 01 00 00 00 00 06
						FF FF 98 06
						04 00
					05 01 00 00 78 00 02
						11 00																								
					05 01 00 00 14 00 02
						29 00
					23 01 00 00 00 00 02
						35 00																	
											
					];
		qcom,mdss-dsi-off-command = [05 01 00 00 32 00 02 28 00
					05 01 00 00 78 00 02 10 00];
		qcom,mdss-dsi-on-command-state = "dsi_lp_mode";
		qcom,mdss-dsi-off-command-state = "dsi_lp_mode";
		qcom,mdss-dsi-h-sync-pulse = <1>;
		qcom,mdss-dsi-traffic-mode = "burst_mode";
		qcom,mdss-dsi-lane-map = "lane_map_3012";
		qcom,mdss-dsi-bllp-eof-power-mode;
		qcom,mdss-dsi-bllp-power-mode;
		qcom,mdss-dsi-lane-0-state;
		qcom,mdss-dsi-lane-1-state;
		qcom,mdss-dsi-panel-timings = [33 1A 10  00 3E 40
						 16 1C 15 03 04 00];
		qcom,mdss-dsi-t-clk-post = <0x04>;
		qcom,mdss-dsi-t-clk-pre = <0x1b>;
		qcom,mdss-dsi-bl-min-level = <1>;
		qcom,mdss-dsi-bl-max-level = <4095>;
		qcom,mdss-dsi-dma-trigger = "trigger_sw";
		qcom,mdss-dsi-mdp-trigger = "none";
		qcom,mdss-dsi-bl-pmic-control-type = "bl_ctrl_pwm";
		qcom,mdss-dsi-bl-pmic-pwm-frequency = <100>;
		qcom,mdss-dsi-bl-pmic-bank-select = <0>;
		qcom,mdss-dsi-pwm-gpio = <&pm8916_mpps 4 0>;
		qcom,mdss-dsi-reset-sequence = <1 20>, <0 10>, <1 60>;
		qcom,mdss-dsi-hfp-power-mode;
		qcom,mdss-dsi-hbp-power-mode;
		qcom,mdss-dsi-hsa-power-mode;

	};
};
