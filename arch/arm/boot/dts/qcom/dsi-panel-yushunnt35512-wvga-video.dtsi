/* Copyright (c) 2013, The Linux Foundation. All rights reserved.
 *
 * This program is free software; you can redistribute it and/or modify
 * it under the terms of the GNU General Public License version 2 and
 * only version 2 as published by the Free Software Foundation.
 *
 * This program is distributed in the hope that it will be useful,
 * but WITHOUT ANY WARRANTY; without even the implied warranty of
 * MERCHANTABILITY or FITNESS FOR A PARTICULAR PURPOSE.  See the
 * GNU General Public License for more details.
 */

/*---------------------------------------------------------------------------
 * This file is autogenerated file using gcdb parser. Please do not edit it.
 * Update input XML file to add a new entry or update variable in this file
 * VERSION = "1.0"
 *---------------------------------------------------------------------------*/
&mdss_mdp {
	dsi_yushunnt35512_wvga_vid: qcom,mdss_dsi_yushunnt35512_wvga_video {
		qcom,mdss-dsi-panel-name = "YS NT35512 video mode dsi panel";
		qcom,mdss-dsi-panel-controller = <&mdss_dsi0>;
		qcom,mdss-dsi-panel-type = "dsi_video_mode";
		qcom,mdss-dsi-panel-destination = "display_1";
		qcom,cont-splash-enabled;
		qcom,mdss-dsi-panel-framerate = <60>;
		qcom,mdss-dsi-virtual-channel-id = <0>;
		qcom,mdss-dsi-stream = <0>;
		qcom,mdss-dsi-panel-width = <480>;
		qcom,mdss-dsi-panel-height = <800>;
		qcom,mdss-dsi-h-front-porch = <80>;
		qcom,mdss-dsi-h-back-porch = <80>;
		qcom,mdss-dsi-h-pulse-width = <10>;
		qcom,mdss-dsi-h-sync-skew = <0>;
		qcom,mdss-dsi-v-back-porch = <15>;
		qcom,mdss-dsi-v-front-porch = <16>;
		qcom,mdss-dsi-v-pulse-width = <6>;
		qcom,mdss-dsi-h-left-border = <0>;
		qcom,mdss-dsi-h-right-border = <0>;
		qcom,mdss-dsi-v-top-border = <0>;
		qcom,mdss-dsi-v-bottom-border = <0>;
		qcom,mdss-dsi-bpp = <24>;
		qcom,mdss-dsi-color-order = "rgb_swap_rgb";
		qcom,mdss-dsi-underflow-color = <0xff>;
		qcom,mdss-dsi-border-color = <0>;
		qcom,mdss-dsi-on-command = [
        29 01 00 00 00 00 05
         FF AA 55 A5 
         80
        29 01 00 00 00 00 10
         F4 80 00 55 
         00 04 31 20 
         10 45 32 31 
         73 FF 75 0A
        29 01 00 00 00 00 06
         F0 55 AA 52 
         08 00
        29 01 00 00 00 00 04
         BC 00 00 00
        23 01 00 00 00 00 02
         B6 05
        29 01 00 00 00 00 03
         B7 00 00
        29 01 00 00 00 00 05
         B8 01 05 05 
         05
        23 01 00 00 00 00 02
         BA 01
        29 01 00 00 00 00 03
         B1 FC 00
        29 01 00 00 00 00 04
         CC 03 00 00
        29 01 00 00 00 00 06
         BD 01 84 1C 
         1C 00
        29 01 00 00 00 00 06
         F0 55 AA 52 
         08 01 
        29 01 00 00 00 00 04
         B0 0A 0A 0A
        29 01 00 00 00 00 04
         B6 44 44 44
        29 01 00 00 00 00 04
         B1 0A 0A 0A
        29 01 00 00 00 00 04
         B7 34 34 34
        29 01 00 00 00 00 04
         B3 05 05 05
        29 01 00 00 00 00 04
         B9 34 34 34
        29 01 00 00 00 00 04
         B5 0B 0B 0B
        29 01 00 00 00 00 04
         BA 24 24 24
        23 01 00 00 00 00 02
         C2 01
        23 01 00 00 00 00 02
         BF 00
        29 01 00 00 00 00 03
         BE 00 4A
        29 01 00 00 00 00 04
         Bc 00 88 00
        29 01 00 00 00 00 04
         Bd 00 88 00
        29 01 00 00 00 00 35
         D1 00 13 00 
         41 00 77 00 
         94 00 A9 00 
         CC 00 EA 01 
         16 01 3B 01 
         75 01 A5 01 
         EE 02 28 02 
         2C 02 60 02 
         97 02 B9 02 
         E9 03 0A 03 
         40 03 4B 03 
         8C 03 AC 03 
         CD 03 E4 03 
         EC
        29 01 00 00 00 00 35
         D2 00 04 00 
         3A 00 6C 00 
         8B 00 A2 00 
         C6 00 E3 01 
         12 01 36 01 
         71 01 9F 01 
         E9 02 27 02 
         28 02 5E 02 
         96 02 B8 02 
         E9 03 0D 03 
         42 03 50 03 
         8F 03 AF 03 
         CF 03 F4 03 
         F5
        29 01 00 00 00 00 35
         D3 00 44 00 
         54 00 73 00 
         8B 00 9F 00 
         BE 00 DA 01 
         07 01 2C 01 
         68 01 98 01 
         E5 02 24 02 
         26 02 5D 02 
         95 02 B8 02 
         ED 03 18 03 
         78 03 F1 03 
         F6 03 F8 03 
         FA 03 FD 03 
         FE
        29 01 00 00 00 00 35
         D4 00 13 00 
         41 00 77 00 
         94 00 A9 00 
         CC 00 EA 01 
         16 01 3B 01 
         75 01 A5 01 
         EE 02 28 02 
         2C 02 60 02 
         97 02 B9 02 
         E9 03 0A 03 
         40 03 4B 03 
         8C 03 AC 03 
         CD 03 E4 03 
         EC
        29 01 00 00 00 00 35
         D5 00 04 00 
         3A 00 6C 00 
         8B 00 A2 00 
         C6 00 E3 01 
         12 01 36 01 
         71 01 9F 01 
         E9 02 27 02 
         28 02 5E 02 
         96 02 B8 02 
         E9 03 0D 03 
         42 03 50 03 
         8F 03 AF 03 
         CF 03 F4 03 
         F5
        29 01 00 00 00 00 35
         D6 00 44 00 
         54 00 73 00 
         8B 00 9F 00 
         BE 00 DA 01 
         07 01 2C 01 
         68 01 98 01 
         E5 02 24 02 
         26 02 5D 02 
         95 02 B8 02 
         ED 03 18 03 
         78 03 F1 03 
         F6 03 F8 03 
         FA 03 FD 03 
         FE
        23 01 00 00 00 00 02
         36 00
        23 01 00 00 00 00 02
         3a 77
        05 01 00 00 78 00 02
         11 00																								
        05 01 00 00 14 00 02
         29 00												
        											
					];
		qcom,mdss-dsi-off-command = [05 01 00 00 32 00 02 28 00
					05 01 00 00 78 00 02 10 00];
		qcom,mdss-dsi-on-command-state = "dsi_lp_mode";
		qcom,mdss-dsi-off-command-state = "dsi_lp_mode";
		qcom,mdss-dsi-panel-status-command = [06 01 00 01 05 00 02 0A 08];
		qcom,mdss-dsi-panel-status-command-state = "dsi_lp_mode";
		qcom,mdss-dsi-panel-status-check-mode = "reg_read";
		qcom,mdss-dsi-panel-status-value = <0x9c>;
		qcom,esd-check-enabled;
		qcom,mdss-dsi-h-sync-pulse = <0>;
		qcom,mdss-dsi-traffic-mode = "non_burst_sync_pulse";
		qcom,mdss-dsi-lane-map = "lane_map_3012";
		qcom,mdss-dsi-bllp-eof-power-mode;
		qcom,mdss-dsi-bllp-power-mode;
		qcom,mdss-dsi-lane-0-state;
		qcom,mdss-dsi-lane-1-state;
		qcom,mdss-dsi-panel-timings = [76 18 10  00 3C 3E
						 14 1C 12 03 04 00];
		qcom,mdss-dsi-t-clk-post = <0x04>;
		qcom,mdss-dsi-t-clk-pre = <0x1b>;
		qcom,mdss-dsi-bl-min-level = <1>;
		qcom,mdss-dsi-bl-max-level = <4095>;
		qcom,mdss-dsi-dma-trigger = "trigger_sw";
		qcom,mdss-dsi-mdp-trigger = "none";
		qcom,mdss-dsi-bl-pmic-control-type = "bl_ctrl_pwm";
		qcom,mdss-dsi-bl-pmic-pwm-frequency = <100>;
		qcom,mdss-dsi-bl-pmic-bank-select = <0>;
		qcom,mdss-dsi-pwm-gpio = <&pm8916_mpps 4 0>;
		qcom,mdss-dsi-reset-sequence = <1 20>, <0 10>, <1 20>;

	};
};
