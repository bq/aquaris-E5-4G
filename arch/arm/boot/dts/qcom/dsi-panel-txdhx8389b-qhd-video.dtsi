/* Copyright (c) 2013, The Linux Foundation. All rights reserved.
 *
 * This program is free software; you can redistribute it and/or modify
 * it under the terms of the GNU General Public License version 2 and
 * only version 2 as published by the Free Software Foundation.
 *
 * This program is distributed in the hope that it will be useful,
 * but WITHOUT ANY WARRANTY; without even the implied warranty of
 * MERCHANTABILITY or FITNESS FOR A PARTICULAR PURPOSE.  See the
 * GNU General Public License for more details.
 */

/*---------------------------------------------------------------------------
 * This file is autogenerated file using gcdb parser. Please do not edit it.
 * Update input XML file to add a new entry or update variable in this file
 * VERSION = "1.0"
 *---------------------------------------------------------------------------*/
&mdss_mdp {
	dsi_txdhx8389B_qhd_vid: qcom,mdss_dsi_txdhx8389B_qhd_video {
		qcom,mdss-dsi-panel-name = "TXD OTM9605A qhd video mode dsi panel";
		qcom,mdss-dsi-panel-controller = <&mdss_dsi0>;
		qcom,mdss-dsi-panel-type = "dsi_video_mode";
		qcom,mdss-dsi-panel-destination = "display_1";
		qcom,cont-splash-enabled;
		qcom,mdss-dsi-panel-framerate = <60>;
		qcom,mdss-dsi-virtual-channel-id = <0>;
		qcom,mdss-dsi-stream = <0>;
		qcom,mdss-dsi-panel-width = <540>;
		qcom,mdss-dsi-panel-height = <960>;
		qcom,mdss-dsi-h-front-porch = <60>;
		qcom,mdss-dsi-h-back-porch = <60>;
		qcom,mdss-dsi-h-pulse-width = <30>;
		qcom,mdss-dsi-h-sync-skew = <0>;
		qcom,mdss-dsi-v-back-porch = <15>;
		qcom,mdss-dsi-v-front-porch = <20>;
		qcom,mdss-dsi-v-pulse-width = <2>;
		qcom,mdss-dsi-h-left-border = <0>;
		qcom,mdss-dsi-h-right-border = <0>;
		qcom,mdss-dsi-v-top-border = <0>;
		qcom,mdss-dsi-v-bottom-border = <0>;
		qcom,mdss-dsi-bpp = <24>;
		qcom,mdss-dsi-color-order = "rgb_swap_rgb";
		qcom,mdss-dsi-underflow-color = <0xff>;
		qcom,mdss-dsi-border-color = <0>;
		qcom,mdss-dsi-on-command = [
		   39 01 00 00 01 00 04 
          B9 FF 83 89
          
       39 01 00 00 01 00 08 
          BA 41 83 00 16 A4 00 18 
          
       39 01 00 00 01 00 14 
          B1 00 00 04 E8 50 10 11 
          B1 F1 36 3E 28 28 42 01 
          5A F7 00 E6 
          
       39 01 00 00 01 00 08 
          B2 00 00 78 08 0B 3F 80 
          
       39 01 00 00 01 00 20 
          B4 80 08 00 32 10 06 30 
          13 D2 00 00 00 3F 0A 40 
          08 37 0A 40 14 46 50 0A 
          0A 40 0A 40 14 46 50 0A 
          
       39 01 00 00 01 00 31 
          D5 00 00 00 00 01 00 00 
          00 A0 10 88 88 88 01 08 
          48 81 85 28 68 83 87 05 
          88 48 88 88 88 88 88 88 
          88 10 78 38 86 82 58 10 
          84 80 84 80 58 88 88 88 
          88 
          
       39 01 00 00 01 00 23 
          E0 05 11 14 37 3F 3F 20 
          4F 08 0E 0D 12 14 12 14 
          1D 1C 05 11 14 37 3F 3F 
          20 4F 08 0E 0D 12 14 12 
          14 1D 1C 
          
       39 01 00 00 01 00 80 
          C1 01 00 07 1C 2A 34 3F 
          49 52 5B 63 6A 71 78 7F 
          85 8B 91 97 9D A3 A8 AF 
          B5 BE C6 C9 CD D7 E1 E6 
          F1 F7 FF 34 CB 4F D9 54 
          C8 3C 4A C0 00 07 1C 2A 
          34 3F 49 52 5B 63 6A 71 
          78 7F 85 8B 91 97 9D A3 
          A8 AF B5 BE C6 C9 CD D7 
          E1 E6 F1 F7 FF 34 CB 4F 
          D9 54 C8 3C 4A C0 00 07 
          1C 2A 34 3F 49 52 5B 63 
          6A 71 78 7F 85 8B 91 97 
          9D A3 A8 AF B5 BE C6 C9 
          CD D7 E1 E6 F1 F7 FF 34 
          CB 4F D9 54 C8 3C 4A C0 

       23 01 00 00 01 00 02
       		CC 02
       39 01 00 00 01 00 05 
       		B6 00 9E 00 9E 
       23 01 00 00 01 00 02 
       		C6 08
			 05 01 00 00 7F 00 02
					11 00
			 05 01 00 00 14 00 02
					29 00																
					];
		qcom,mdss-dsi-off-command = [05 01 00 00 32 00 02 28 00
					05 01 00 00 78 00 02 10 00];
		qcom,mdss-dsi-on-command-state = "dsi_lp_mode";
		qcom,mdss-dsi-off-command-state = "dsi_lp_mode";
		qcom,mdss-dsi-h-sync-pulse = <0>;
		qcom,mdss-dsi-traffic-mode = "non_burst_sync_pulse";
		qcom,mdss-dsi-lane-map = "lane_map_0123";
		qcom,mdss-dsi-bllp-eof-power-mode;
		qcom,mdss-dsi-bllp-power-mode;
		qcom,mdss-dsi-lane-0-state;
		qcom,mdss-dsi-lane-1-state;
		qcom,mdss-dsi-panel-timings = [93 1E 14 00 44 48
						 18 22 19 03 04 00];
		qcom,mdss-dsi-t-clk-post = <0x04>;
		qcom,mdss-dsi-t-clk-pre = <0x1b>;
		qcom,mdss-dsi-bl-min-level = <1>;
		qcom,mdss-dsi-bl-max-level = <4095>;
		qcom,mdss-dsi-dma-trigger = "trigger_sw";
		qcom,mdss-dsi-mdp-trigger = "none";
		qcom,mdss-dsi-bl-pmic-control-type = "bl_ctrl_pwm";
		qcom,mdss-dsi-bl-pmic-pwm-frequency = <100>;
		qcom,mdss-dsi-bl-pmic-bank-select = <0>;
		qcom,mdss-dsi-pwm-gpio = <&pm8916_mpps 4 0>;
		qcom,mdss-dsi-reset-sequence = <1 20>, <0 20>, <1 120>;

	};
};
