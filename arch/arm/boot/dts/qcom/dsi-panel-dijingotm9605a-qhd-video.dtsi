/* Copyright (c) 2013, The Linux Foundation. All rights reserved.
 *
 * This program is free software; you can redistribute it and/or modify
 * it under the terms of the GNU General Public License version 2 and
 * only version 2 as published by the Free Software Foundation.
 *
 * This program is distributed in the hope that it will be useful,
 * but WITHOUT ANY WARRANTY; without even the implied warranty of
 * MERCHANTABILITY or FITNESS FOR A PARTICULAR PURPOSE.  See the
 * GNU General Public License for more details.
 */

/*---------------------------------------------------------------------------
 * This file is autogenerated file using gcdb parser. Please do not edit it.
 * Update input XML file to add a new entry or update variable in this file
 * VERSION = "1.0"
 *---------------------------------------------------------------------------*/
&mdss_mdp {
	dsi_dijingotm9605a_qhd_vid: qcom,mdss_dsi_dijingotm9605a_qhd_video {
		qcom,mdss-dsi-panel-name = "DJN OTM9605A qhd video mode dsi panel";
		qcom,mdss-dsi-panel-controller = <&mdss_dsi0>;
		qcom,mdss-dsi-panel-type = "dsi_video_mode";
		qcom,mdss-dsi-panel-destination = "display_1";
		qcom,cont-splash-enabled;
		qcom,mdss-dsi-panel-framerate = <60>;
		qcom,mdss-dsi-virtual-channel-id = <0>;
		qcom,mdss-dsi-stream = <0>;
		qcom,mdss-dsi-panel-width = <540>;
		qcom,mdss-dsi-panel-height = <960>;
		qcom,mdss-dsi-h-front-porch = <40>;
		qcom,mdss-dsi-h-back-porch = <40>;
		qcom,mdss-dsi-h-pulse-width = <10>;
		qcom,mdss-dsi-h-sync-skew = <0>;
		qcom,mdss-dsi-v-back-porch = <14>;
		qcom,mdss-dsi-v-front-porch = <20>;
		qcom,mdss-dsi-v-pulse-width = <6>;
		qcom,mdss-dsi-h-left-border = <0>;
		qcom,mdss-dsi-h-right-border = <0>;
		qcom,mdss-dsi-v-top-border = <0>;
		qcom,mdss-dsi-v-bottom-border = <0>;
		qcom,mdss-dsi-bpp = <24>;
		qcom,mdss-dsi-color-order = "rgb_swap_rgb";
		qcom,mdss-dsi-underflow-color = <0xff>;
		qcom,mdss-dsi-border-color = <0>;
		qcom,mdss-dsi-on-command = [
23 01 00 00 00 00 02 00 00 
29 01 00 00 00 00 04 FF 96 05 01 
23 01 00 00 00 00 02 00 80 
29 01 00 00 00 00 03 FF 96 05 

23 01 00 00 00 00 02 00 92 
29 01 00 00 00 00 03 FF 10 02 

23 01 00 00 00 00 02 00 00 
23 01 00 00 00 00 02 00 00 
23 01 00 00 00 00 02 00 00 
23 01 00 00 00 00 02 00 00 
23 01 00 00 00 00 02 00 00 
23 01 00 00 00 00 02 00 00 
23 01 00 00 00 00 02 00 00 
23 01 00 00 00 00 02 00 00 

23 01 00 00 00 00 02 00 00 
23 01 00 00 00 00 02 A0 00 
                   
23 01 00 00 00 00 02 00 A0 
23 01 00 00 00 00 02 C1 00 
23 01 00 00 00 00 02 00 80 
29 01 00 00 00 00 03 C1 36 66 
23 01 00 00 00 00 02 00 89 
23 01 00 00 00 00 02 C0 01 
23 01 00 00 00 00 02 00 B1 
23 01 00 00 00 00 02 C5 28 
23 01 00 00 00 00 02 00 C0 
23 01 00 00 00 00 02 C5 00 
23 01 00 00 00 00 02 00 80 
23 01 00 00 00 00 02 C4 9C 
                   
23 01 00 00 00 00 02 00 90 
29 01 00 00 00 00 07 C0 00 44 00 00 00 03 

23 01 00 00 00 00 02 00 B4 
23 01 00 00 00 00 02 C0 10 
                   
23 01 00 00 00 00 02 00 A6 
29 01 00 00 00 00 04 C1 00 00 00 

23 01 00 00 00 00 02 00 91 
23 01 00 00 00 00 02 C5 76 
23 01 00 00 00 00 02 00 93 
23 01 00 00 00 00 02 C5 76 
                   
23 01 00 00 00 00 02 00 94 
23 01 00 00 00 00 02 C5 55 
23 01 00 00 00 00 02 00 95 
23 01 00 00 00 00 02 C5 55 


23 01 00 00 00 00 02 00 B2 
29 01 00 00 00 00 05 F5 15 00 15 00 

23 01 00 00 00 00 02 00 80 
29 01 00 00 00 00 0B CB 00 00 00 00 00 00 00 00 00 00 
23 01 00 00 00 00 02 00 90 
29 01 00 00 00 00 10 CB 00 00 00 00 00 00 00 00 00 00 00 00 00 00 00 
23 01 00 00 00 00 02 00 A0 
29 01 00 00 00 00 10 CB 00 00 00 00 00 00 00 00 00 00 00 00 00 00 00 
23 01 00 00 00 00 02 00 B0 
29 01 00 00 00 00 0B CB 00 00 00 00 00 00 00 00 00 00 
23 01 00 00 00 00 02 00 C0 
29 01 00 00 00 00 10 CB 00 00 00 04 00 00 04 04 00 00 04 04 04 00 00 
23 01 00 00 00 00 02 00 D0 
29 01 00 00 00 00 10 CB 00 00 00 00 00 00 00 00 04 04 04 00 00 04 04 
23 01 00 00 00 00 02 00 E0 
29 01 00 00 00 00 0B CB 00 00 00 00 04 00 00 00 00 00 
23 01 00 00 00 00 02 00 F0 
29 01 00 00 00 00 0B CB FF FF FF FF FF FF FF FF FF FF 
23 01 00 00 00 00 02 00 80 
29 01 00 00 00 00 0B CC 00 00 00 02 00 00 0A 0E 00 00 
23 01 00 00 00 00 02 00 90 
29 01 00 00 00 00 10 CC 0C 10 06 00 00 00 00 00 00 00 00 00 00 01 09 
23 01 00 00 00 00 02 00 A0 
29 01 00 00 00 00 10 CC 0D 00 00 0B 0F 00 00 00 00 05 00 00 00 00 00 
23 01 00 00 00 00 02 00 B0 
29 01 00 00 00 00 0B CC 00 00 00 02 00 00 0A 0E 00 00 
23 01 00 00 00 00 02 00 C0 
29 01 00 00 00 00 10 CC 0C 10 06 00 00 00 00 00 00 00 00 00 00 01 09 
23 01 00 00 00 00 02 00 D0 
29 01 00 00 00 00 10 CC 0D 00 00 0B 0F 00 00 00 00 05 00 00 00 00 00 
23 01 00 00 00 00 02 00 80 
29 01 00 00 00 00 0D CE 85 03 18 84 03 18 00 0F 00 00 0F 00 
23 01 00 00 00 00 02 00 90 
29 01 00 00 00 00 0F CE 33 C5 18 33 C6 18 F0 00 00 F0 00 00 00 00 
23 01 00 00 00 00 02 00 A0 
29 01 00 00 00 00 0F CE 38 03 03 BF 00 18 00 38 02 03 C0 00 18 00 
23 01 00 00 00 00 02 00 B0 
29 01 00 00 00 00 0F CE 38 01 03 C1 00 18 00 38 00 03 C2 00 18 00 
23 01 00 00 00 00 02 00 C0 
29 01 00 00 00 00 0F CE 30 00 03 C3 00 18 00 30 01 03 C4 00 18 00 
23 01 00 00 00 00 02 00 D0 
29 01 00 00 00 00 0F CE 30 02 03 C5 00 18 00 30 03 03 C6 00 18 00 
23 01 00 00 00 00 02 00 80 
29 01 00 00 00 00 0F CF F0 00 00 10 00 00 00 F0 00 00 10 00 00 00 
23 01 00 00 00 00 02 00 90 
29 01 00 00 00 00 0F CF F0 00 00 10 00 00 00 F0 00 00 10 00 00 00 
23 01 00 00 00 00 02 00 A0 
29 01 00 00 00 00 0F CF F0 00 00 10 00 00 00 F0 00 00 10 00 00 00 
23 01 00 00 00 00 02 00 B0 
29 01 00 00 00 00 0F CF F0 00 00 10 00 00 00 F0 00 00 10 00 00 00 
23 01 00 00 00 00 02 00 C0 
29 01 00 00 00 00 0B CF 01 01 20 20 00 00 02 00 00 00 

23 01 00 00 00 00 02 00 00 
29 01 00 00 00 00 03 D8 67 67 
23 01 00 00 00 00 02 00 00 
23 01 00 00 00 00 02 D9 62 
23 01 00 00 00 00 02 00 00 
29 01 00 00 00 00 11 E1 02 06 0A 0C 05 0C 0A 08 05 08 0F 09 10 18 12 08 
23 01 00 00 00 00 02 00 00 
29 01 00 00 00 00 11 E2 02 07 0A 0C 05 0B 0A 08 05 08 0F 09 10 18 12 08 

23 01 00 00 00 00 02 00 B1 
23 01 00 00 00 00 02 C5 28 

23 01 00 00 00 00 02 00 80 
23 01 00 00 00 00 02 C4 9C 

23 01 00 00 00 00 02 00 C0 
23 01 00 00 00 00 02 C5 00 

23 01 00 00 00 00 02 00 B2 
29 01 00 00 00 00 05 F5 15 00 15 00 

23 01 00 00 00 00 02 00 93 
23 01 00 00 00 00 02 C5 03 

23 01 00 00 00 00 02 00 80 
29 01 00 00 00 00 03 C1 36 66 

23 01 00 00 00 00 02 00 89 
23 01 00 00 00 00 02 C0 01 

23 01 00 00 00 00 02 00 A0 
23 01 00 00 00 00 02 C1 00 

23 01 00 00 00 00 02 00 C5 
23 01 00 00 00 00 02 B0 03 
23 01 00 00 00 00 02 00 00 
29 01 00 00 00 00 04 FF FF FF FF 

05 01 00 00 32 00 02 11 00																								

05 01 00 00 14 00 02 29 00												
											
					];
		qcom,mdss-dsi-off-command = [05 01 00 00 32 00 02 28 00
					05 01 00 00 78 00 02 10 00];
		qcom,mdss-dsi-on-command-state = "dsi_lp_mode";
		qcom,mdss-dsi-off-command-state = "dsi_lp_mode";
		qcom,mdss-dsi-h-sync-pulse = <0>;
		qcom,mdss-dsi-traffic-mode = "non_burst_sync_pulse";
		qcom,mdss-dsi-lane-map = "lane_map_0123";
		qcom,mdss-dsi-bllp-eof-power-mode;
		qcom,mdss-dsi-bllp-power-mode;
		qcom,mdss-dsi-lane-0-state;
		qcom,mdss-dsi-lane-1-state;
		qcom,mdss-dsi-panel-timings = [87 1C 12 00 42 42
						 18 20 17 03 04 00];
		qcom,mdss-dsi-t-clk-post = <0x04>;
		qcom,mdss-dsi-t-clk-pre = <0x1b>;
		qcom,mdss-dsi-bl-min-level = <1>;
		qcom,mdss-dsi-bl-max-level = <4095>;
		qcom,mdss-dsi-dma-trigger = "trigger_sw";
		qcom,mdss-dsi-mdp-trigger = "none";
		qcom,mdss-dsi-bl-pmic-control-type = "bl_ctrl_pwm";
		qcom,mdss-dsi-bl-pmic-pwm-frequency = <100>;
		qcom,mdss-dsi-bl-pmic-bank-select = <0>;
		qcom,mdss-dsi-pwm-gpio = <&pm8916_mpps 4 0>;
		qcom,mdss-dsi-reset-sequence = <1 20>, <0 20>, <1 20>;

	};
};
